## firmware/boards/elecrow_s3_lcd_7/sdkconfig.defaults
```kconfig
# SPDX-License-Identifier: GPL-3.0-or-later
# Board-specific Kconfig defaults for Elecrow ESP32-S3 7" (v2, v3, Advance).
# Standard module: ESP32-S3-WROOM-1-N4R8 (4 MB QIO flash, 8 MB octal PSRAM).
# If your device has 8 or 16 MB flash, switch to partitions/8M.csv or
# partitions/16M.csv and set the matching FLASHSIZE option.

# ----- Flash (4 MB, QIO @ 80 MHz) -----
CONFIG_ESPTOOLPY_FLASHSIZE_4MB=y
CONFIG_ESPTOOLPY_FLASHMODE_QIO=y
CONFIG_ESPTOOLPY_FLASHFREQ_80M=y
CONFIG_PARTITION_TABLE_CUSTOM_FILENAME="partitions/4M.csv"

# ----- PSRAM (8 MB, octal SPI @ 80 MHz) -----
CONFIG_SPIRAM=y
CONFIG_SPIRAM_MODE_OCT=y
CONFIG_SPIRAM_SPEED_80M=y
CONFIG_SPIRAM_FETCH_INSTRUCTIONS=y
CONFIG_SPIRAM_RODATA=y
CONFIG_ESP32S3_DATA_CACHE_LINE_64B=y

# ----- Host transport: touchy protocol over serial (UART fallback) -----
# GPIO19/20 (USB D+/D-) are also the I2C bus for PCA9557 and GT911,
# so native USB is not usable.  Use UART0 via the USB-UART bridge instead.
# Stage LB5: declare the board's protocol UART (UART0); the UartLink is
# created because CONFIG_TOUCHY_PROTO_OVER_UART defaults y. The vendor-USB
# link's flag also defaults y, but USB is unwired here so it never
# enumerates (harmless); set CONFIG_TOUCHY_PROTO_OVER_VENDORUSB=n if you
# want to drop that idle task.
CONFIG_TOUCHY_HAS_PROTO_UART=y
CONFIG_TOUCHY_PROTO_UART_NUM=0
CONFIG_ESP_CONSOLE_UART_DEFAULT=y
CONFIG_TOUCHY_LOG_OVER_PROTO=y
```

## firmware/boards/esp32_2432s024/sdkconfig.defaults
```kconfig
# SPDX-License-Identifier: GPL-3.0-or-later
# Board-specific Kconfig defaults for the ESP32-2432S024 ("Cheap Yellow
# Display", 2.4" CYD2USB variant).
#
#   - MCU:     classic ESP32-D0WD-V3 (Xtensa LX6, set-target esp32),
#              520 KB SRAM, NO PSRAM, 4 MB flash.
#   - Display: 2.4" 320x240 ILI9341 over SPI (vs ST7789 on the 2432S028Rv3 —
#              this is the only hardware difference; all C++ is shared via
#              boards/cyd_common/).
#   - Touch:   XPT2046 resistive on a separate SPI bus.
#   - Host link: NO native USB. A CH340 UART bridge (UART0) is the only
#                connection to the host, so the touchy protocol rides UART0.

# ----- Flash (4 MB, DIO @ 80 MHz; CYD modules are typically DIO) -----
CONFIG_ESPTOOLPY_FLASHSIZE_4MB=y
CONFIG_ESPTOOLPY_FLASHMODE_DIO=y
CONFIG_ESPTOOLPY_FLASHFREQ_80M=y
CONFIG_PARTITION_TABLE_CUSTOM_FILENAME="partitions/4M.csv"
# Enable the dedicated Boya flash driver — boards with BY25Q64 / BY25Q128 chips
# otherwise fall back to the generic driver and print a warning at boot.
CONFIG_SPI_FLASH_SUPPORT_BOYA_CHIP=y

# ----- No PSRAM on this module -----
# (CONFIG_SPIRAM intentionally left unset.) The 'R:' ramdisk still works —
# RamFs prefers MALLOC_CAP_SPIRAM but falls back to internal RAM when PSRAM is
# absent (see fs/ram_fs.cpp), so image assets are supported, just bounded by
# the ~520 KB internal SRAM instead of PSRAM.

# ----- Host transport: touchy protocol over the CH340 UART (UART0) -----
# This board has no USB-OTG (CONFIG_SOC_USB_OTG_SUPPORTED is unset for the
# classic ESP32), so the vendor-bulk link does not exist. The protocol
# instead rides UART0 via the Stage 65 UartLink.
CONFIG_TOUCHY_PROTO_OVER_SERIAL=y

# Use default UART settings and log over our protobufs (Stage 64.1 tunnel) so
# the protocol UART carries only binary frames, never raw console text.
CONFIG_ESP_CONSOLE_UART_DEFAULT=y
CONFIG_TOUCHY_LOG_OVER_PROTO=y
# CRITICAL: the protocol rides UART0, so the device must NOT also forward raw
# ESP_LOG text to UART0 — that interleaves byte-for-byte with the binary
# protocol frames and desyncs the host's frame decoder (it mis-reads a length
# field and then waits forever for bytes that never arrive). The global
# default (firmware/sdkconfig.defaults) is CONFIG_TOUCHY_LOG_TO_UART=y, which
# is fine for native-USB boards (their console UART is a *separate* wire from
# the USB-CDC protocol link) but harmful here. Turn it off so logs reach the
# host only via the LogRecord tunnel. (Mirrors the esp32_2432s028rv3 board.)
# NOTE: `# CONFIG_X is not set` is the real X=n directive in sdkconfig syntax.
# CONFIG_TOUCHY_LOG_TO_UART is not set

# ----- First-light bring-up override (manual; do NOT leave enabled) ---------
# Before the protocol link is trusted it can be handy to see boot logs on a
# serial monitor. For that, temporarily edit the options above:
#   - replace CONFIG_TOUCHY_PROTO_OVER_SERIAL=y with CONFIG_TOUCHY_PROTO_OVER_SERIAL=n
# That disables the binary protocol so the console UART carries logs only.
# NEVER ship with that config.
#
# NOTE: do not express those overrides here as `# CONFIG_X is not set` lines —
# in sdkconfig syntax that is the *real* directive for X=n (not a comment) and
# would silently undo the settings above.
```

## firmware/boards/esp32_2432s028rv3/sdkconfig.defaults
```kconfig
# SPDX-License-Identifier: GPL-3.0-or-later
# Board-specific Kconfig defaults for the ESP32-2432S028Rv3 ("Cheap Yellow
# Display", CYD2USB variant).
#
#   - MCU:     classic ESP32-D0WD-V3 (Xtensa LX6, set-target esp32),
#              520 KB SRAM, NO PSRAM, 4 MB flash.
#   - Display: 2.8" 320x240 ST7789/ILI9341 over SPI.
#   - Touch:   XPT2046 resistive on a separate SPI bus.
#   - Host link: NO native USB. A CH340 UART bridge (UART0) is the only
#                connection to the host, so the touchy protocol rides UART0.

# ----- Flash (4 MB, DIO @ 80 MHz; CYD modules are typically DIO) -----
CONFIG_ESPTOOLPY_FLASHSIZE_4MB=y
CONFIG_ESPTOOLPY_FLASHMODE_DIO=y
CONFIG_ESPTOOLPY_FLASHFREQ_80M=y
CONFIG_PARTITION_TABLE_CUSTOM_FILENAME="partitions/4M.csv"
# Enable the dedicated Boya flash driver — boards with BY25Q64 / BY25Q128 chips
# otherwise fall back to the generic driver and print a warning at boot.
CONFIG_SPI_FLASH_SUPPORT_BOYA_CHIP=y

# ----- No PSRAM on this module -----
# (CONFIG_SPIRAM intentionally left unset.) The 'R:' ramdisk still works —
# RamFs prefers MALLOC_CAP_SPIRAM but falls back to internal RAM when PSRAM is
# absent (see fs/ram_fs.cpp), so image assets are supported, just bounded by
# the ~520 KB internal SRAM instead of PSRAM.

# ----- Host transport: touchy protocol over the CH340 UART (UART0) -----
# This board has no USB-OTG (CONFIG_SOC_USB_OTG_SUPPORTED is unset for the
# classic ESP32), so the vendor-bulk link does not exist. The protocol
# instead rides UART0 via the Stage 65 UartLink.
CONFIG_TOUCHY_PROTO_OVER_SERIAL=y

# Keep the IDF console OFF UART0 so its log text never interleaves with the
# binary protocol frames. Device ESP_LOG output reaches the host through the
# Stage 64.1 LogRecord tunnel instead (CONFIG_TOUCHY_LOG_OVER_PROTO=y, the
# common default), so we lose nothing by silencing the raw UART console.
#CONFIG_ESP_CONSOLE_UART_NONE=y
# CONFIG_TOUCHY_LOG_TO_UART has no effect once the console UART is disabled,
# but set it explicitly so intent is clear.
# CONFIG_TOUCHY_LOG_TO_UART is not set

# Use default UART settings and change to log over our protobufs
CONFIG_ESP_CONSOLE_UART_DEFAULT=y
CONFIG_TOUCHY_LOG_OVER_PROTO=y

# ----- First-light bring-up override (manual; do NOT leave enabled) ---------
# Before the protocol link is trusted it can be handy to see boot logs on a
# serial monitor. For that, temporarily edit the options above:
#   - replace CONFIG_ESP_CONSOLE_UART_NONE=y with CONFIG_ESP_CONSOLE_UART_DEFAULT=y
#   - replace CONFIG_TOUCHY_PROTO_OVER_SERIAL=y with CONFIG_TOUCHY_PROTO_OVER_SERIAL=n
# CONFIG_TOUCHY_PROTO_OVER_SERIAL=n
# That re-routes the console to UART0 (human-readable text) and disables the
# binary protocol so the port carries logs only. NEVER ship with that config.
#
# NOTE: do not express those overrides here as `# CONFIG_X is not set` lines —
# in sdkconfig syntax that is the *real* directive for X=n (not a comment) and
# would silently undo the settings above.

# Temporarily turn off display on this board for early bring-up
# CONFIG_TOUCHY_NO_DISPLAY=y
```

## firmware/boards/esp32_s3_matrix/sdkconfig.defaults
```kconfig
# SPDX-License-Identifier: GPL-3.0-or-later
# Board-specific Kconfig defaults for the Waveshare ESP32-S3-Matrix
# (ESP32-S3FH4R2: 4 MB QIO flash, 2 MB quad PSRAM).
#
# Display-less / touch-less LED-matrix board: an 8×8 WS2812B matrix on
# GPIO 14, driven by the shared boards/common/leds/ driver. Panel geometry
# and wiring arrive at runtime from the persisted BoardConfig preference
# (Stage lb6/lb10), so no compile-time LED_PANEL_* macros here.

# ----- Flash (4 MB, QIO @ 80 MHz) -----
CONFIG_ESPTOOLPY_FLASHSIZE_4MB=y
CONFIG_ESPTOOLPY_FLASHMODE_QIO=y
CONFIG_ESPTOOLPY_FLASHFREQ_80M=y
CONFIG_PARTITION_TABLE_CUSTOM_FILENAME="partitions/4M.csv"

# ----- PSRAM (2 MB, quad SPI @ 80 MHz) -----
CONFIG_SPIRAM=y
CONFIG_SPIRAM_MODE_QUAD=y
CONFIG_SPIRAM_SPEED_80M=y
CONFIG_SPIRAM_FETCH_INSTRUCTIONS=y
CONFIG_SPIRAM_RODATA=y

# ----- Host transport: native USB vendor bulk only (Stage LB5) -----
# The board has no dedicated UART wired to the host, so the protocol runs
# over the native USB-OTG vendor-bulk interface. UART and CDC-ACM protocol
# links are left disabled; the common defaults route the IDF console to
# UART0. Device logs are tunneled to the host via the protobuf LogRecord
# channel (CONFIG_TOUCHY_LOG_OVER_PROTO=y in the common sdkconfig.defaults).
CONFIG_TOUCHY_NO_TOUCH=y
```

## firmware/boards/feather_esp32_s3/sdkconfig.defaults
```kconfig
# SPDX-License-Identifier: GPL-3.0-or-later
# Board-specific Kconfig defaults for the Adafruit ESP32-S3 Feather
# LED-matrix board (Stage LB2). Display-less / touch-less: drives one 8x32
# WS2812B matrix as an LVGL display over the RMT peripheral (DMA). This is
# the mainstream-hardware twin of the jc_esp32p4_m3 board, used to prove the
# LB1 software stack on silicon that actually boots today.
#
# Target module: Adafruit ESP32-S3 Feather, N16R8 variant
# (16 MB QIO flash, 8 MB octal PSRAM), native USB-OTG.

# ----- Flash (16 MB, QIO @ 80 MHz) -----
# 80 MHz is the safe tier under ESP-IDF 6.x (no HPM-DC dance required).
CONFIG_ESPTOOLPY_FLASHSIZE_16MB=y
CONFIG_ESPTOOLPY_FLASHMODE_QIO=y
CONFIG_ESPTOOLPY_FLASHFREQ_80M=y
CONFIG_PARTITION_TABLE_CUSTOM_FILENAME="partitions/16M.csv"

# ----- PSRAM (8 MB, octal SPI @ 80 MHz) -----
# Required by the N16R8 board variant.
CONFIG_SPIRAM=y
CONFIG_SPIRAM_MODE_OCT=y
CONFIG_SPIRAM_SPEED_80M=y
CONFIG_SPIRAM_FETCH_INSTRUCTIONS=y
CONFIG_SPIRAM_RODATA=y
CONFIG_ESP32S3_DATA_CACHE_LINE_64B=y

# ----- Host transport: native USB via USB-OTG + a hardware UART (Stage LB5) -----
# The vendor-USB link is on by default (CONFIG_TOUCHY_PROTO_OVER_VENDORUSB=y
# + native USB-OTG). Stage LB5 additionally brings up the hardware-UART link
# so a client can connect over *either* interface. Declare the board's
# protocol UART (UART0); CONFIG_TOUCHY_PROTO_OVER_UART defaults y so the link
# is created. Route the IDF console to the separate USB-Serial-JTAG so its
# log text never interleaves with the binary protocol frames on UART0.
CONFIG_TOUCHY_LOG_OVER_PROTO=y
CONFIG_TOUCHY_HAS_PROTO_UART=y
CONFIG_TOUCHY_PROTO_UART_NUM=0
CONFIG_TOUCHY_PROTO_UART_TXD=43
CONFIG_TOUCHY_PROTO_UART_RXD=44
CONFIG_ESP_CONSOLE_USB_SERIAL_JTAG=y

# ----- Stage LB2: touch-less board -----
# No touch panel; select the colour-swatch built-in default screen and skip
# touch bring-up. (Runtime counterpart: platform_is_touchable() override.)
CONFIG_TOUCHY_NO_TOUCH=y
```

## firmware/boards/jc4827w543/sdkconfig.defaults
```kconfig
# SPDX-License-Identifier: Apache-2.0
# Board-specific Kconfig defaults for the JC4827W543 board
# (ESP32-S3 with 4 MB QSPI flash, 8 MB OPI PSRAM).

# ----- Flash (4 MB, QIO @ 80 MHz) -----
CONFIG_ESPTOOLPY_FLASHSIZE_4MB=y
CONFIG_ESPTOOLPY_FLASHMODE_QIO=y
CONFIG_ESPTOOLPY_FLASHFREQ_80M=y
CONFIG_PARTITION_TABLE_CUSTOM_FILENAME="boards/jc4827w543/partitions.csv"

# ----- PSRAM (8 MB, octal SPI @ 80 MHz) -----
CONFIG_SPIRAM=y
CONFIG_SPIRAM_MODE_OCT=y
CONFIG_SPIRAM_SPEED_80M=y
CONFIG_SPIRAM_FETCH_INSTRUCTIONS=y
CONFIG_SPIRAM_RODATA=y
CONFIG_ESP32S3_DATA_CACHE_LINE_64B=y

# ----- LVGL: feed pixels to the NV3041A QSPI panel in big-endian RGB565.
# The panel expects MSB-first 16-bit colour on the wire. LVGL v9 no longer
# has a CONFIG_LV_COLOR_16_SWAP option; the byte swap is performed by the
# flush_cb in boards/jc4827w543/board/display.cpp via lv_draw_sw_rgb565_swap.
```

## firmware/boards/jc_esp32p4_m3/sdkconfig.defaults
```kconfig
# SPDX-License-Identifier: GPL-3.0-or-later
# Board-specific Kconfig defaults for the Guition JC-ESP32P4-M3 LED-matrix
# board (Stage LB1). Display-less / touch-less: drives one 8x32 WS2812B
# matrix as an LVGL display over the RMT peripheral (DMA).

# ----- Flash (16 MB) -----
CONFIG_ESPTOOLPY_FLASHSIZE_16MB=y
CONFIG_PARTITION_TABLE_CUSTOM_FILENAME="partitions/16M.csv"

# ----- CPU: 360 MHz (safe for v1.x silicon; 400 MHz requires v3.x) -----
CONFIG_ESP_DEFAULT_CPU_FREQ_MHZ_360=y

# ----- PSRAM: 32 MB hex-PSRAM -----
# 250 MHz requires v3.x silicon; 200 MHz is the max for v1.x.
CONFIG_SPIRAM=y
CONFIG_SPIRAM_SPEED_200M=y

# this board has old silicon v1.3!
# NOTE! Support of ESP32-P4 rev. <3.0 and >=3.0 is mutually exclusive
#
CONFIG_ESP32P4_SELECTS_REV_LESS_V3=y
# CONFIG_ESP32P4_REV_MIN_0 is not set
# CONFIG_ESP32P4_REV_MIN_1 is not set
CONFIG_ESP32P4_REV_MIN_100=y

# ----- LVGL: disable Xtensa/ARM-specific optimizations (P4 is RISC-V) -----
CONFIG_LV_USE_DRAW_ARM2D_SYNC=n
CONFIG_LV_USE_NATIVE_HELIUM_ASM=n

# ----- v1.x has no ECDSA hardware peripheral -----
CONFIG_MBEDTLS_HARDWARE_ECDSA_SIGN=n
CONFIG_MBEDTLS_HARDWARE_ECDSA_VERIFY=n

# ----- Host transport: native USB via USB-OTG -----
CONFIG_TOUCHY_LOG_OVER_PROTO=y

# ----- Stage LB1: touch-less board -----
# No touch panel; select the colour-swatch built-in default screen and skip
# touch bring-up. (Runtime counterpart: platform_is_touchable() override.)
CONFIG_TOUCHY_NO_TOUCH=y
```

## firmware/boards/matouch_43/sdkconfig.defaults
```kconfig
# SPDX-License-Identifier: GPL-3.0-or-later
# Board-specific Kconfig defaults for the MakerFabs MaTouch 4.3"
# Module: ESP32-S3-WROOM-1-N16R8 (16 MB QIO flash, 8 MB OPI PSRAM).

# ----- Flash (16 MB, QIO @ 80 MHz) -----
CONFIG_ESPTOOLPY_FLASHSIZE_16MB=y
CONFIG_ESPTOOLPY_FLASHMODE_QIO=y
CONFIG_ESPTOOLPY_FLASHFREQ_80M=y
CONFIG_PARTITION_TABLE_CUSTOM_FILENAME="partitions/16M.csv"

# ----- PSRAM (8 MB, octal SPI @ 80 MHz) -----
CONFIG_SPIRAM=y
CONFIG_SPIRAM_MODE_OCT=y
CONFIG_SPIRAM_SPEED_80M=y
CONFIG_SPIRAM_FETCH_INSTRUCTIONS=y
CONFIG_SPIRAM_RODATA=y
CONFIG_ESP32S3_DATA_CACHE_LINE_64B=y

# GPIO19/20 are not used by display or touch, so native USB-OTG is available.
# No CONFIG_TOUCHY_PROTO_OVER_SERIAL needed.
```

## firmware/boards/waveshare_s3_lcd_7b/sdkconfig.defaults
```kconfig
# SPDX-License-Identifier: Apache-2.0
# Board-specific Kconfig defaults for Waveshare ESP32-S3-Touch-LCD-7B
# (ESP32-S3-N16R8: 16 MB QIO flash, 8 MB octal PSRAM).

# ----- Flash (16 MB, QIO @ 80 MHz) -----
# 120 MHz HPM mode hits broken code paths in ESP-IDF 6.0.1 unless
# CONFIG_BOOTLOADER_FLASH_DC_AWARE is also set; the safe 80 MHz tier avoids
# the HPM-DC dance entirely.
CONFIG_ESPTOOLPY_FLASHSIZE_16MB=y
CONFIG_ESPTOOLPY_FLASHMODE_QIO=y
CONFIG_ESPTOOLPY_FLASHFREQ_80M=y
CONFIG_PARTITION_TABLE_CUSTOM_FILENAME="boards/waveshare_s3_lcd_7b/partitions.csv"

# ----- PSRAM (8 MB, octal SPI @ 80 MHz) -----
# Required by the N16R8 board variant. IDF 6.0.1 has missing MSPI tuning
# tables for (core 240M, flash 80M) so we run PSRAM/CPU at 80M/160M.
CONFIG_SPIRAM=y
CONFIG_SPIRAM_MODE_OCT=y
CONFIG_SPIRAM_SPEED_80M=y
CONFIG_SPIRAM_FETCH_INSTRUCTIONS=y
CONFIG_SPIRAM_RODATA=y
CONFIG_ESP32S3_DATA_CACHE_LINE_64B=y
```
