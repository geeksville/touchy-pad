## firmware/sdkconfig.defaults
```kconfig
# SPDX-License-Identifier: GPL-3.0-or-later
# Common defaults for touchy-pad v2 (all boards).
#
# Per-board overrides (flash size, PSRAM mode, partition CSV, pixel clock,
# etc.) live in boards/<board>/sdkconfig.defaults and are layered on top of
# this file by the top-level CMakeLists.txt.

# ----- Target -----
CONFIG_IDF_TARGET="esp32s3"

# ----- CPU / FreeRTOS -----
# Try to run faster because it helps FPS and my test board was fine...
# CONFIG_ESP_DEFAULT_CPU_FREQ_MHZ_160=y
CONFIG_IDF_EXPERIMENTAL_FEATURES=y
CONFIG_ESP_DEFAULT_CPU_FREQ_MHZ_240=y

CONFIG_FREERTOS_HZ=1000
CONFIG_COMPILER_OPTIMIZATION_PERF=y
# Required by uxTaskGetSystemState() (used by screens.cpp:dump_critical_info).
CONFIG_FREERTOS_USE_TRACE_FACILITY=y

# Stage 24.2 — `Screen.active` is a recursive `Widget` (with nested
# `Layout.children`), and nanopb's `pb_release` walks the tree
# recursively at boot to free the version-probe decode of each
# host-uploaded screen. The default 3584-byte main task stack overflows
# during this release for non-trivial screens (observed: a ~415-byte
# encoded screen with one grid + a couple of widgets, on the second file
# in the boot scan, smashes the stack and the device crashes during
# board_init right after screens_init returns). 16 KB gives plenty of
# headroom for arbitrary user-provisioned screens.
CONFIG_ESP_MAIN_TASK_STACK_SIZE=16384

# Trip a clean panic + backtrace if the main (or any) task ever does
# overflow again, instead of silently corrupting whatever lives below
# the stack.
CONFIG_FREERTOS_CHECK_STACKOVERFLOW_CANARY=y

# ----- Console / UART -----
# Primary console: UART0.  This works at boot, before USB enumerates, and
# when no USB host is connected.  The USB-Serial/JTAG controller is disabled
# because it shares the OTG D+/D- pins (GPIO 19/20) with TinyUSB; leaving it
# enabled causes a brief enumeration conflict on power-up.
# A second copy of log output is forwarded to the TinyUSB CDC-ACM interface
# at runtime by calling esp_tusb_init_console() after tinyusb_driver_install().
CONFIG_ESP_CONSOLE_UART_DEFAULT=y
CONFIG_ESP_CONSOLE_SECONDARY_NONE=y
CONFIG_USJ_ENABLE_USB_SERIAL_JTAG=n

# ----- USB (TinyUSB composite: HID mouse/keyboard + custom vendor) -----
# Stage 64.2: CDC-ACM is *disabled* to save endpoint slots on the
# ESP32-S3 USB-OTG controller (5 IN + 5 OUT total) so we can
# eventually grow a dedicated interrupt-IN event mailbox. Device
# log output is tunneled over the vendor bulk pair instead (see
# Stage 64.1, `CONFIG_TOUCHY_LOG_OVER_PROTO`). Set
# CONFIG_TINYUSB_CDC_ENABLED=y in a per-board sdkconfig to bring
# the serial console back temporarily for debugging.
CONFIG_TINYUSB_DEBUG_LEVEL=0
CONFIG_TINYUSB_CDC_ENABLED=n
CONFIG_TINYUSB_HID_COUNT=1
# Stage 13: custom vendor interface for the host_api command/response/event
# protocol (see docs/host-api.md). esp_tinyusb derives CFG_TUD_VENDOR from
# this count, which compiles in tud_vendor_* support so we can drive the
# bulk OUT/IN endpoints from host_api.cpp.
CONFIG_TINYUSB_VENDOR_COUNT=1

# ----- LVGL (v9) -----
# Route LVGL's stdlib bindings to libc so esp_heap_caps / newlib are used for
# malloc/memcpy/memset/sprintf (replaces v8's LV_MEM_CUSTOM=y).

# per https://lvgl.io/docs/open/integration/chip_vendors/espressif/tips_and_tricks LVGL speedups
# CONFIG_LV_ATTRIBUTE_FAST_MEM_USE_IRAM=y

CONFIG_LV_USE_CLIB_MALLOC=y
CONFIG_LV_USE_CLIB_STRING=y
CONFIG_LV_USE_CLIB_SPRINTF=y
# LVGL 9.5 places several draw functions in numbered .iram1.N sections; GCC
# rejects the conflicting attributes when LV_ATTRIBUTE_FAST_MEM_USE_IRAM is
# enabled (compile error -Werror=attributes on lv_draw_sw_blend_to_a8.c).
# Keep the FAST_MEM attribute as a no-op until upstream resolves this.
# CONFIG_LV_ATTRIBUTE_FAST_MEM_USE_IRAM is not set
CONFIG_LV_COLOR_DEPTH_16=y
# CONFIG_LV_USE_PERF_MONITOR=y
CONFIG_LV_FONT_MONTSERRAT_16=y
CONFIG_LV_FONT_MONTSERRAT_30=y
# Stage 20: LVGL POSIX filesystem bridge so host-uploaded image assets
# in /littlefs/from_host/ can back Image / ImageButton widgets.
# 'F' (ASCII 70) is the drive letter; paths look like F:/from_host/<asset>.
CONFIG_LV_USE_FS_POSIX=y
CONFIG_LV_FS_POSIX_LETTER=70
CONFIG_LV_FS_POSIX_PATH="/littlefs"
# Native LVGL .bin decoder: the host converts BMP/PNG/JPEG/GIF/WebP to
# this container before upload (see touchy_pad.lvgl_image.to_lvgl_bin).
# RAM_LOAD=y is REQUIRED for scale/rotation: the SW transform path
# indexes into the full decoded image, but with RAM_LOAD=n the bin
# decoder only feeds line-by-line via get_area_cb, so transforming an
# image renders garbage (random pixels from adjacent file data).
CONFIG_LV_BIN_DECODER_RAM_LOAD=y
# Stage 80: native animated-GIF decoder (lv_gif). The host uploads GIFs
# verbatim and the firmware renders them in RGB565 with auto-pause when
# off-screen. Frame buffers are allocated via LVGL's CLIB malloc, which
# prefers PSRAM on boards that have it.
CONFIG_LV_USE_GIF=y
# Doesnt increase FPS
# CONFIG_LV_USE_DRAW_SW_ASM=255

# ----- Log -----
# DEBUG (4) so ESP_LOGD lines are both *compiled in* (MAXIMUM_LEVEL) and
# *emitted at runtime* (DEFAULT_LEVEL). The Stage 80 GIF reload probes
# and any other ESP_LOGD diagnostics are invisible unless both are >= 4;
# with the default INFO the compiler strips ESP_LOGD bodies entirely.

# Turn these flags on to see LOGD records.  
CONFIG_LOG_MAXIMUM_LEVEL_DEBUG=y

# WARNING: for some reason turning this on makes the boot fail sometimes
CONFIG_LOG_DEFAULT_LEVEL_DEBUG=y
# CONFIG_LOG_DEFAULT_LEVEL_INFO=y

# ----- Custom partition table (filename supplied per-board) -----
CONFIG_PARTITION_TABLE_CUSTOM=y

# ----- Crash / panic diagnostics -----
# Goal: when the firmware faults, get as much useful info out of UART0
# (and the post-reboot CDC console) as possible before the device resets.
# See discussion in chat: TinyUSB CDC cannot be serviced from inside the
# panic handler, so panic text only ever reaches UART0 in real time.

# Hold the CPU in the panic handler for a few seconds so any in-flight
# UART bytes flush and a human-attached terminal can see the dump before
# the watchdog or auto-reset clobbers it.
CONFIG_ESP_SYSTEM_PANIC_PRINT_REBOOT=y
CONFIG_ESP_SYSTEM_PANIC_REBOOT_DELAY_SECONDS=10

# Run the panic handler from IRAM so it still works when the flash cache
# is disabled (e.g. faults during SPI flash ops or from ISRs).
CONFIG_ESP_PANIC_HANDLER_IRAM=y

# Interrupt + task watchdogs: if a task or ISR hangs, panic with a full
# backtrace of the offending task rather than silently wedging.
CONFIG_ESP_INT_WDT=y
CONFIG_ESP_INT_WDT_TIMEOUT_MS=300
CONFIG_ESP_TASK_WDT_EN=y
CONFIG_ESP_TASK_WDT_PANIC=y

# Save an ELF core dump to the `coredump` flash partition on panic. We
# have no UART console wired on the shipped boards, so the only way to
# recover a real backtrace is to persist it across the reboot and stream
# it back over the proto log tunnel — coredump_report.cpp decodes the
# summary (faulting task, PC, backtrace) on the next boot, logs it, then
# erases the image. Enabling this auto-selects ELF format + SHA256
# checksum, which is what esp_core_dump_get_summary() consumes.
CONFIG_ESP_COREDUMP_ENABLE_TO_FLASH=y

# ----- LVGL runtime asserts -----
# Catch the most common LVGL misuse 
# at the point of misuse, with an LV_LOG_ERROR + backtrace, instead of
# letting it cascade into an unprintable memory-corruption panic.
CONFIG_LV_USE_LOG=y
CONFIG_LV_LOG_LEVEL_WARN=y
CONFIG_LV_USE_ASSERT_NULL=y
CONFIG_LV_USE_ASSERT_MALLOC=y
CONFIG_LV_USE_ASSERT_OBJ=y
CONFIG_LV_USE_ASSERT_STYLE=y

# ----- Touchy-Pad project options (see firmware/main/Kconfig.projbuild) -----
# Stage 64.1: tunnel ESP-IDF log lines to the host via Response.log_record
# payloads on the existing host_api channel. Enabled by default; boards
# without a real USB-CDC console (e.g. CYD2USB) keep this on and disable
# the UART forward via CONFIG_TOUCHY_LOG_TO_UART=n.
CONFIG_TOUCHY_LOG_OVER_PROTO=y
CONFIG_TOUCHY_LOG_TO_UART=y

# The following debug flags collectively cost us 6 FPS (from 26 -> 20 FPS) but worth it for
# now for better debugging.
# Expensive debugging flags!
# Catch heap corruption at the point of the bad write rather than waiting
# for a downstream allocator crash. Comprehensive mode adds head/tail
# canaries on every block and fills freed memory with 0xFE so
# use-after-free reads are obvious in the dump.
#CONFIG_HEAP_POISONING_COMPREHENSIVE=y
#CONFIG_HEAP_TASK_TRACKING=y
# Stack-overflow detection: canary is already on above; this additionally
# arms a hardware watchpoint at the end of every task stack so the fault
# fires on the *first* over-the-edge write instead of at the next context
# switch.
#CONFIG_FREERTOS_WATCHPOINT_END_OF_STACK=y
# GCC stack protector (cheap, catches classic buffer-overrun smashes with
# a clean __stack_chk_fail panic + backtrace).
#CONFIG_COMPILER_STACK_CHECK_MODE_NORM=y
#
# Use .eh_frame unwind info so backtraces survive across non-trivial C++
# call sites (exception tables present anyway).
#CONFIG_ESP_SYSTEM_USE_EH_FRAME=y
```

## v2/boards/jc4827w543/sdkconfig.defaults
```kconfig
# SPDX-License-Identifier: Apache-2.0
# Board-specific Kconfig defaults for the JC4827W543 board
# (ESP32-S3 with 4 MB QSPI flash, 8 MB OPI PSRAM).

# ----- Flash (4 MB, QIO @ 80 MHz) -----
CONFIG_ESPTOOLPY_FLASHSIZE_4MB=y
CONFIG_ESPTOOLPY_FLASHMODE_QIO=y
CONFIG_ESPTOOLPY_FLASHFREQ_80M=y
CONFIG_PARTITION_TABLE_CUSTOM_FILENAME="boards/jc4827w543/partitions.csv"

# ----- PSRAM (8 MB, octal SPI @ 80 MHz) -----
CONFIG_SPIRAM=y
CONFIG_SPIRAM_MODE_OCT=y
CONFIG_SPIRAM_SPEED_80M=y
CONFIG_SPIRAM_FETCH_INSTRUCTIONS=y
CONFIG_SPIRAM_RODATA=y
CONFIG_ESP32S3_DATA_CACHE_LINE_64B=y
```

## v2/sdkconfig.defaults
```kconfig
# SPDX-License-Identifier: Apache-2.0
# Common defaults for touchy-pad v2 (all boards).
#
# Per-board overrides (flash size, PSRAM mode, partition CSV, pixel clock,
# etc.) live in boards/<board>/sdkconfig.defaults and are layered on top of
# this file by the top-level CMakeLists.txt.

# ----- Target -----
CONFIG_IDF_TARGET="esp32s3"

# ----- CPU / FreeRTOS -----
CONFIG_ESP_DEFAULT_CPU_FREQ_MHZ_160=y
CONFIG_FREERTOS_HZ=1000
CONFIG_COMPILER_OPTIMIZATION_PERF=y

# ----- Console / UART -----
# By default ESP32-S3 routes the console through the built-in USB
# Serial/JTAG controller, which holds the USB D+/D- pins and prevents
# TinyUSB from enumerating as a HID device. Switch the console to UART0
# so the OTG peripheral is free for HID.
CONFIG_ESP_CONSOLE_UART_DEFAULT=y
CONFIG_ESP_CONSOLE_SECONDARY_NONE=y
CONFIG_USJ_ENABLE_USB_SERIAL_JTAG=n

# ----- USB (TinyUSB device, HID mouse) -----
CONFIG_TINYUSB_DEBUG_LEVEL=0
CONFIG_TINYUSB_HID_COUNT=1

# ----- LVGL -----
CONFIG_LV_MEM_CUSTOM=y
CONFIG_LV_MEMCPY_MEMSET_STD=y
CONFIG_LV_ATTRIBUTE_FAST_MEM_USE_IRAM=y
CONFIG_LV_COLOR_DEPTH_16=y
CONFIG_LV_USE_PERF_MONITOR=n
CONFIG_LV_FONT_MONTSERRAT_16=y
CONFIG_LV_FONT_MONTSERRAT_30=y

# ----- Log -----
CONFIG_LOG_DEFAULT_LEVEL_INFO=y

# ----- Custom partition table (filename supplied per-board) -----
CONFIG_PARTITION_TABLE_CUSTOM=y
```
