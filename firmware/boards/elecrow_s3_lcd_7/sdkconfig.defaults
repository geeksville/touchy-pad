## firmware/main/Kconfig.projbuild
```kconfig
# SPDX-License-Identifier: GPL-3.0-or-later
#
# Project-level Kconfig options for touchy-pad. Exposed as
# CONFIG_TOUCHY_* macros at build time. See sdkconfig.defaults for the
# defaults applied to every board.

menu "Touchy-Pad"

config TOUCHY_LOG_OVER_PROTO
    bool "Tunnel ESP-IDF logs to host over the touchy protobuf channel"
    default y
    help
        When enabled, esp_log_set_vprintf() is hooked so log lines are
        also queued for the host. The host drains them as
        Response.log_record payloads returned from its normal
        EventConsumeCmd polling loop (no new endpoint, no new
        command). Required for boards without a real USB-CDC port
        (Stage 64.2 CYD2USB).

config TOUCHY_LOG_TO_UART
    bool "Also forward ESP-IDF logs to the original UART/CDC console"
    depends on TOUCHY_LOG_OVER_PROTO
    default y
    help
        When TOUCHY_LOG_OVER_PROTO is enabled, the original
        esp_log_set_vprintf() handler is preserved so log lines
        continue to appear on the UART / TinyUSB-CDC console in
        addition to being tunneled to the host. Disable on boards
        with no usable physical console (e.g. CYD2USB) to skip the
        forward and save a few cycles per log line.

config TOUCHY_PROTO_OVER_VENDORUSB
    bool "Serve the touchy protobuf protocol over the USB vendor-bulk interface"
    default y
    help
        Enables the USB vendor-bulk host_api link (VendorLink). Only
        instantiated when the chip actually has a native USB-OTG
        controller (CONFIG_SOC_USB_OTG_SUPPORTED); on a board without one
        the flag has no effect. This is the primary transport on every
        native-USB board, so it defaults on.

config TOUCHY_PROTO_OVER_CDCACM
    bool "Also serve the touchy protobuf protocol over a USB-CDC ACM port"
    default n
    help
        Enables the USB-CDC ACM host_api link (SerialLink). Only
        instantiated when the chip has native USB-OTG *and* the TinyUSB
        CDC class is compiled in (CONFIG_TINYUSB_CDC_ENABLED, so
        CONFIG_TINYUSB_CDC_COUNT > 0). Off by default because most boards
        keep the CDC port for the human-readable console rather than the
        binary protocol; the CDC port must carry *only* protocol frames
        when this is set (route logs to the host via
        TOUCHY_LOG_OVER_PROTO instead).

config TOUCHY_PROTO_OVER_UART
    bool "Also serve the touchy protobuf protocol over a hardware UART"
    default y
    help
        Enables the hardware-UART host_api link (UartLink). Only
        instantiated when the board declares it wires a dedicated UART for
        the protocol (TOUCHY_HAS_PROTO_UART); a board that declares none
        never builds the link even though this defaults on. Used on
        boards with no usable native USB (e.g. the classic-ESP32 CYD
        boards, reached through their USB-UART bridge).

config TOUCHY_HAS_PROTO_UART
    bool "Board wires a dedicated hardware UART for the protocol"
    default n
    help
        Set by a board's sdkconfig.defaults when it has a hardware UART
        wired for the touchy protocol (e.g. a CH340 USB-UART bridge on
        UART0). This is the "required hardware" gate for the UartLink:
        TOUCHY_PROTO_OVER_UART only creates the link when this is also y.
        See TOUCHY_PROTO_UART_NUM / TOUCHY_PROTO_UART_BAUD.

config TOUCHY_PROTO_UART_NUM
    int "Hardware UART port number for the protocol link"
    depends on TOUCHY_HAS_PROTO_UART
    default 0
    help
        The UART controller the protocol UartLink drives. Defaults to
        UART0, which on the CYD boards is wired to the CH340 bridge. Keep
        the IDF console off this port (CONFIG_ESP_CONSOLE_UART_NONE or a
        different console UART) so log text never interleaves with the
        binary protocol frames.

config TOUCHY_PROTO_UART_BAUD
    int "Protocol UART baud rate"
    depends on TOUCHY_HAS_PROTO_UART
    default 460800
    help
        Baud rate for the protocol UartLink. Must match the host-side
        serial transport.

config TOUCHY_PROTO_UART_TXD
    int "Protocol UART TXD GPIO (-1 = hardware default)"
    depends on TOUCHY_HAS_PROTO_UART
    default -1
    help
        GPIO number for the protocol UART's TX pin. -1 keeps the
        hardware-default pin assignment (UART_PIN_NO_CHANGE). Set to the
        board's wired TXD GPIO when the default pin is wrong for your
        board (e.g. shared with another peripheral).

config TOUCHY_PROTO_UART_RXD
    int "Protocol UART RXD GPIO (-1 = hardware default)"
    depends on TOUCHY_HAS_PROTO_UART
    default -1
    help
        GPIO number for the protocol UART's RX pin. -1 keeps the
        hardware-default pin assignment (UART_PIN_NO_CHANGE). Set to the
        board's wired RXD GPIO when the default pin is wrong for your
        board.


config TOUCHY_NO_TOUCH
    bool "Board has no touch panel"
    default n
    help
        Set on display-less / touch-less boards (Stage LB1 LED-matrix
        boards such as jc_esp32p4_m3). It selects the touch-less built-in
        default screen (a set of colour swatches) compiled into
        default_screen_pb.h instead of the trackpad-based one, and lets
        the firmware skip touch_init(). This is a compile-time counterpart
        to the runtime Platform.is_touchable flag reported to the host.

config TOUCHY_NO_DISPLAY
    bool "Disable the display + touchscreen hardware"
    default n
    help
        When enabled, the board's panel and touch controller are never
        initialised. Instead an off-screen ("headless") LVGL display is
        created so the screen / host_api stack keeps working unchanged —
        screens still build and render into a discarded framebuffer, and
        touch simply never produces events. Useful when bringing up a new
        board whose display or touch drivers are still buggy: you can
        exercise USB, the protocol and the filesystem without the panel
        crashing the boot. A single warning is logged at startup; there is
        no per-use logging. See TOUCHY_HEADLESS_HRES / TOUCHY_HEADLESS_VRES
        for the off-screen resolution.

config TOUCHY_HEADLESS_HRES
    int "Headless display width (px)"
    depends on TOUCHY_NO_DISPLAY
    default 480
    help
        Horizontal resolution of the off-screen LVGL display used when
        TOUCHY_NO_DISPLAY is set. Match your intended panel so screen
        layouts size themselves the same as they will on real hardware.

config TOUCHY_HEADLESS_VRES
    int "Headless display height (px)"
    depends on TOUCHY_NO_DISPLAY
    default 272
    help
        Vertical resolution of the off-screen LVGL display used when
        TOUCHY_NO_DISPLAY is set.

config TOUCHY_WIFI
    bool "Enable WiFi + the HTTP(S) network command API (Stage lb8/lb9)"
    default y if SOC_WIFI_SUPPORTED
    default n
    help
        Compiles the WiFi station bring-up, mDNS advertisement, and the
        HTTP(S) protobuf command API (firmware/main/net/). At runtime the
        radio stays off until the host programs WiFi credentials into the
        NetworkConfig preference (`touchy pref wifi-set-ssid/-psk`), at
        which point the device joins the network and serves the protocol
        over POST /touchy/api/v1/command. If mutual-TLS certs have been
        provisioned (F:tls/*, via `touchy pref provision-mtls`) the API is
        HTTPS-with-mTLS-only on 443 and the plaintext port is disabled;
        otherwise it is plaintext HTTP on 80. Automatically off on chips
        with no WiFi radio (e.g. the ESP32-P4), where the whole subsystem
        is compiled out.

endmenu
```
